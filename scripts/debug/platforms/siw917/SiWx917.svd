# RS1xxxx register map
Vendor: Silicon Lab Inc.; Series: ARMCM4; File version: 1.2
ARM 32-bit Cortex-M4 Microcontroller based device, CPU clock up to 80MHz, etc.
CPU: CM4 r1p0, little endian, MPU, FPU, 6 interrupt priority bits
Registers are 32-bit, read-write, reset 0x0 unless marked. A register's access mark holds for its fields unless they carry their own. Offsets are from the block's base; lines under a group give offsets from that group; [hi:lo] are bit positions; {n}, {i} and the like mark numbered series; 'fields as' and 'values as' point back to an identical list; <NAME> marks a mode.

## Memory map
0x12000000 QSPI size 0x164 — The queued serial peripheral interface module provides a serial peripheral interface with queued transfer capability
0x12040000 QSPI_2 size 0x184 — The queued serial peripheral interface module provides a serial peripheral interface with queued transfer capability
0x20200000 SDIO_Slave size 0x502 — The Secure Digital I/O (SDIO) Slave module implements the functionality of the SDIO card based on the SDIO specifications version 2.0.
0x20200000 HSPI size 0x802 — The SPI Interface is a full duplex serial host interface, which supports 8-bit and 32-bit data granularity. It also supports gated mode of SPI clock and both the low and the high frequency modes
0x20280000 Instruction_Cache_Controller size 0x48 — The Instruction Cache Controller controls the instruction fetching from External Memory into Local Cache for access to the processor.
0x20480400 IID_RPINE size 0x2C
0x20480500 IID_AES size 0x104 — The AES module provides AES encoding and decoding functionality. It can be used in a microprocessor based environment
0x20480600 IID_QK size 0x104 — The purpose of Quiddikey is to provide secure key storage without storing the key.
0x21080000 GPDMA size 0x734 — GPDMA is an AMBA complaint peripheral unit supports 8-channels
0x24000000 MVP size 0x210 — Matrix Vector Processor Register structure
0x24040000 ULP_I2C size 0x100 — Inter Integrated Circuit(I2C) is programmable control bus that provides support for the communications link between integrated circuits in a system
0x24040400 ULP_I2S size 0x200 — I2S(Inter-IC Sound) is transferring two-channel digital audio data from one IC device to another
0x24040800 ULP_SSI size 0xF8 — Synchronous Serial Interface(SSI)
0x24040C00 IR_Decoder size 0x1C — IR Decoder are used for the decoding the external ir sensor input.
0x24041400 ULPCLK size 0xA8 — This block provides programming support for miscellaneous blocks in the chip. Various features in the chip are enabled using this.
0x24041800 ULP_UART size 0x100 — Universal Asynchronous Receiver/Transmitter is for serial communication with peripherals, modems and datasets
0x24042000 ULP_TIMERS size 0xA0 — TIMER can be used to generate various timing events for the software
0x24042400 SDC size 0x78 — Sensor Data Collector Register structure
0x24042C00 CTS size 0x124 — The capacitive touch sensor (CTS) controller is used to detect the position of the touch from the user on the capacitive touch screen
0x24043800 AUX_ADC_DAC_COMP size 0x214 — The ADC-DAC Controller works on a ADC with a resolution of 12bits at 5Mega sample per second when ADC reference Voltage is greater than 2.8v or 5Mega sample per second when ADC reference Voltage is less than 2.8v.
0x24043A14 OPAMP size 0xC — The opamps top consists of 3 general purpose Operational Amplifiers (OPAMP) offering rail-to-rail inputs and outputs
0x24048000 UULP_Domain_Ctrl_REGs size 0x24 — NPSS has always ON domain logic which is not power gatable Which consistes of power, reset, isolation controls for different power domains in NPSS.
0x24048000 MCU_ULP_VBAT_CLOCK_ARCHITECTURE size 0x3 — clock select registers for the ULP VBAT peripherals
0x24048100 MCU_FSM size 0x4C — This is explain the Sleep FSM registers.
0x24048100 MCU_ULP_CLOCK_OSCILLATORS size 0x2 — ULP Clock Oscillators Control Registers
0x24048200 Sleep_Clock_Calibrator size 0x1C — In this the time periods of 32KHz RC clock, 32KHz RO clock and 32KHz XTAL clock can be calibrated
0x24048200 Calendar size 0x28 — The MCU calendar acts as RTC with time in seconds, minutes, hours, days, months, years and centuries
0x24048300 WDT size 0x1C — A dedicated window watch dog timer for MCU applications
0x24048400 High_Power_Domain size 0x100 — The use of this is to store some information in ULP over wake-ups to reduce wake-up time
0x24048400 Low_Power_Domain size 0x100 — The use of this is to store some information in ULP over wake-ups to reduce wake-up time
0x24048500 MCU_TEMP size 0x14 — The temperature sensor is used to read the temperature by using APB registers, which is access through direct to ULPSS system.
0x24048500 Secure_Storage size 0x24
0x24048540 MCU_ProcessSensor size 0x4 — The process sensor module, count the process clock (high frequency ring clock) over one MCU FSM clock and divide this clock by programmable value.
0x24048600 MCU_RET size 0x30 — NPSS has Retention domain logic which is a power domain . This domain consisted all logic which will turned off if none of the M4 memories are retained.
0x24048C00 SYSRTC size 0x7C — SYSRTC Register structure
0x2404C000 ULP_EGPIO size 0x1260 — ENHANCED GENERAL PERPOSE INPUT/OUTPUT
0x2405A400 BAND_GAP_TOP size 0x20
0x24070000 FIM size 0x24 — FIM support fixed point Multiplications implemented through programmable shifting.
0x24078000 UDMA1 size 0x830 — DMA Performs data transfers along with Addresses and control information
0x41300000 PAD_SELECTION size 0x16
0x41300110 NWP_FSM size 0x4 — NWP FSM one register Structure
0x44000000 UART0 size 0x100 — Universal Asynchronous Receiver/Transmitter is for serial communication with peripherals, modems and datasets
0x44000100 USART0 size 0x100 — Universal Asynchronous Receiver/Transmitter is for serial communication with peripherals, modems and datasets
0x44010000 I2C0 size 0x100 — Inter Integrated Circuit(I2C) is programmable control bus that provides support for the communications link between integrated circuits in a system
0x44020000 SSI_Master size 0xF8 — Synchronous Serial Interface(SSI)
0x44030000 UDMA0 size 0x830 — DMA Performs data transfers along with Addresses and control information
0x44040000 Data_Cache_Controller size 0x108 — Data Cache controller register map
0x45010000 SSI_Slave size 0xF8 — Synchronous Serial Interface(SSI)
0x45020000 UART1 size 0x100 — Universal Asynchronous Receiver/Transmitter is for serial communication with peripherals, modems and datasets
0x45030000 GSPI_Master size 0xC0 — GSPI, or Generic SPI, is a module which has been derived from QSPI. GSPI can act only as a master
0x45060000 CT0 size 0xB0 — Configurable timer is used in counting clocks, events and states with reference clock external clock and system clock
0x45060100 CT1 size 0xB0 — Configurable timer is used in counting clocks, events and states with reference clock external clock and system clock
0x45061000 CT2 size 0xB0 — Configurable timer is used in counting clocks, events and states with reference clock external clock and system clock
0x45061100 CT3 size 0xB0 — Configurable timer is used in counting clocks, events and states with reference clock external clock and system clock
0x4506F000 CT_MUX_REG size 0x20 — Configurable timer is used in counting clocks, events and states with reference clock external clock and system clock
0x45080000 CRC_Accelerator size 0x3C — CRC is used in all wireless communication as a first data integrity check
0x45090000 HWRNG size 0x8 — Random numbers generated are 16-bit random numbers and are generated using either the True random number generator or the Pseudo random number generator.
0x46000000 M4CLK size 0x88 — MCU HP (High Performance) domain contains the Cortex-M4F Processor, FPU, Debugger, MCU High Speed Interfaces, MCU HP Peripherals, MCU HP DMA and MCU/SZP shareable Interfaces
0x46006000 PAD_CONFIGURATIONs size 0x16 — PAD Configuration registers
0x46008000 MCU_CONFIG size 0x1F8 — MISC CONFIG Register
0x4600C000 EFUSE_Controller size 0x38 — The EFUSE controller is used to provide an interface to one time program memory (EFUSE macro) to perform write and read operations
0x46110000 MCU_MULTI_CHANNEL_INTERRUPT_SELECT size 0x24 — MCU Multi channel interrupt select registers
0x46130000 EGPIO size 0x1260 — ENHANCED GENERAL PERPOSE INPUT/OUTPUT
0x46180000 HF_PLL_Clocks size 0x38 — High frequency PLL clocks registers
0x47000000 SIO size 0x2CC — SERIAL GENERAL PERPOSE INPUT/OUTPUT
0x47040000 I2C1 size 0x100 — Inter Integrated Circuit(I2C) is programmable control bus that provides support for the communications link between integrated circuits in a system
0x47050000 I2S_PCM size 0x200 — I2S(Inter-IC Sound) is transferring two-channel digital audio data from one IC device to another
0x47060000 QEI size 0x50 — The Quadrature Encoder Interface (QEI) module provides the interface to incremental encoders for obtaining mechanical position data
0x47070000 MCPWM size 0x14C — The Motor Control PWM (MCPWM) controller is used to generate a periodic pulse waveform, which is useful in motor control and power control applications
0xE000ED00 SCB size 0x41 — System control block

## Interrupts
2 TIMER0 (ULP_TIMERS)
3 TIMER1 (ULP_TIMERS)
4 TIMER2 (ULP_TIMERS)
5 TIMER3 (ULP_TIMERS)
6 CAP_SENSOR (CTS)
7 COMP2 (AUX_ADC_DAC_COMP)
8 COMP1 (AUX_ADC_DAC_COMP)
10 UDMA1
11 ADC (AUX_ADC_DAC_COMP)
12 ULP_UART
13 I2C2 (ULP_I2C)
14 I2S1 (ULP_I2S)
15 IR_DECODER (IR_Decoder)
16 SSI2 (ULP_SSI)
17 FIM
18 ULP_EGPIO_PIN (ULP_EGPIO)
19 ULP_EGPIO_GROUP (ULP_EGPIO)
20 NPSS_TO_MCU_WDT_INTR (MCU_CONFIG)
21 NPSS_TO_MCU_GPIO_INTR (MCU_CONFIG)
22 NPSS_TO_MCU_CMP_RF_WKP_INTR (MCU_CONFIG)
23 NPSS_TO_MCU_BOD_INTR (MCU_CONFIG)
24 NPSS_TO_MCU_BUTTON_INTR (MCU_CONFIG)
25 NPSS_TO_MCU_SDC_INTR (MCU_CONFIG)
26 NPSS_TO_MCU_WIRELESS_INTR (MCU_CONFIG)
27 NPSS_MCU_INTR (MCU_CONFIG)
28 MCU_CAL_ALARM (MCU_CONFIG)
29 MCU_CAL_RTC (MCU_CONFIG)
31 GPDMA
33 UDMA0
34 CT (CT{n} (n=0..3))
35 HIF0 (MCU_CONFIG)
36 HIF1 (MCU_CONFIG)
37 SIO
38 UART0
38 USART0
39 UART1
41 EGPIO_WAKEUP (MCU_CONFIG)
42 I2C0
44 SSISlave (SSI_Slave)
46 GSPI0 (GSPI_Master)
47 SSI0 (SSI_Master)
48 MCPWM
49 QEI
50 EGPIO_GROUP_0 (EGPIO)
51 EGPIO_GROUP_1 (EGPIO)
{n+52} EGPIO_PIN_{n} (EGPIO, ULP_EGPIO) (n=0..7)
60 QSPI
60 QSPI_2
61 I2C1
62 MVP_INTR (MVP)
63 MVP_WAKEUP_INTR (MVP)
64 I2S0 (I2S_PCM)
69 PLL_CLOCK (MCU_CONFIG)
74 TASS_P2P (MCU_CONFIG)

## Licence text in the file
ARM Limited (ARM) is supplying this software for use with Cortex-M processor based microcontroller, but can be equally used for other suitable processor architectures. This file can be freely distributed. Modifications to this file shall be clearly marked. . THIS SOFTWARE IS PROVIDED "AS IS". NO WARRANTIES, WHETHER EXPRESS, IMPLIED. OR STATUTORY, INCLUDING, BUT NOT LIMITED TO, IMPLIED WARRANTIES OF. MERCHANTABILITY AND FITNESS FOR A PARTICULAR PURPOSE APPLY TO THIS SOFTWARE. ARM SHALL NOT, IN ANY CIRCUMSTANCES, BE LIABLE FOR SPECIAL, INCIDENTAL, OR. CONSEQUENTIAL DAMAGES, FOR ANY REASON WHATSOEVER.

## Notices in the file
Copyright (C) 2012 ARM Limited. All rights reserved.
Purpose: System Viewer Description (SVD) Example (Schema Version 1.1)
This is a description of a none-existent and incomplete device
for demonstration purposes only.
Redistribution and use in source and binary forms, with or without
modification, are permitted provided that the following conditions are met:
- Redistributions of source code must retain the above copyright
notice, this list of conditions and the following disclaimer.
- Redistributions in binary form must reproduce the above copyright
notice, this list of conditions and the following disclaimer in the
documentation and/or other materials provided with the distribution.
- Neither the name of ARM nor the names of its contributors may be used
to endorse or promote products derived from this software without
specific prior written permission.
THIS SOFTWARE IS PROVIDED BY THE COPYRIGHT HOLDERS AND CONTRIBUTORS "AS IS"
AND ANY EXPRESS OR IMPLIED WARRANTIES, INCLUDING, BUT NOT LIMITED TO, THE
ARE DISCLAIMED. IN NO EVENT SHALL COPYRIGHT HOLDERS AND CONTRIBUTORS BE
LIABLE FOR ANY DIRECT, INDIRECT, INCIDENTAL, SPECIAL, EXEMPLARY, OR
CONSEQUENTIAL DAMAGES (INCLUDING, BUT NOT LIMITED TO, PROCUREMENT OF
SUBSTITUTE GOODS OR SERVICES; LOSS OF USE, DATA, OR PROFITS; OR BUSINESS
INTERRUPTION) HOWEVER CAUSED AND ON ANY THEORY OF LIABILITY, WHETHER IN
CONTRACT, STRICT LIABILITY, OR TORT (INCLUDING NEGLIGENCE OR OTHERWISE)
ARISING IN ANY WAY OUT OF THE USE OF THIS SOFTWARE, EVEN IF ADVISED OF THE
POSSIBILITY OF SUCH DAMAGE.
